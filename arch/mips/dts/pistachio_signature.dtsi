/*
 * Copyright (C) 2015 Imagination Technologies Ltd.
 *
 * This program is free software; you can redistribute it and/or modify
 * it under the terms of the GNU General Public License version 2 as
 * published by the Free Software Foundation.
 */


/ {
        signature {
                key-dev {
                        rsa,r-squared = <0xe21cec 0x72d0703d 0x52791ca5 0x754588fc 0xd240998b 0x8d4477d3 0xc5641327 0x5d02ca0c 0x6959340e 0xb9124ce1 0xa018f1fc 0xef6e4830 0x7d5aaa04 0x65b3cd0e 0x3c21215f 0xcf9a2aec 0xf9c77605 0x6430535f 0x8d024878 0x3972e959 0x9d7bbb29 0xa6b7b1a1 0x58b37aae 0xfb9ce135 0x4c0e55cf 0xdf56402e 0x831c3c18 0xe3a21e71 0xdb684ec4 0x43590aa 0x47556562 0x212512c2 0x4863f087 0xa57e1da0 0xc273354c 0xfa08f734 0xa0558ff5 0x35c56a37 0x1366af6c 0xf2d94e20 0x393ebfa2 0xa6fee973 0x8dea1726 0x9c21cbf3 0x3bc52694 0xe40c87ca 0x8873d9ab 0x91534f1c 0xfa518000 0xa1a20754 0x7701be4 0xf34be9d1 0xf987131a 0xbd401ac0 0x1478cd9b 0x7afbddf9 0x41d75dd0 0x6322a7e6 0x6befc661 0x9efa5fc3 0x7c77e35 0x4e1ad398 0xd943c31a 0x6028e54a>;
                        rsa,modulus = <0xc4c30bcb 0x6e85c5bf 0xabee7105 0x8d82d0be 0x82aacef4 0x25e2c5bc 0x634b5302 0x34417230 0xfa5c8a6c 0x2d4959d4 0xa2032513 0x87de0308 0xe25f3e74 0x2bda6f5 0x91cf50e2 0x8ff14bbc 0x65347917 0x4bb1d069 0xe8e6ff04 0xfa34cbb9 0x15e043c0 0x5d962ab0 0x554d093a 0x23b0ab39 0x7d58f443 0x7de070d5 0x3d54658e 0x3cd8d66f 0x971e0fe8 0x75d77f25 0x1e78c299 0x255a90a6 0x38ccc15b 0xe0ea7b20 0x260fe693 0x9b7abaf1 0xf866f47f 0x2f76583f 0xf44a4a9c 0xe74897c 0xfe74d80f 0x9fe12e 0x35156b77 0xcc299b63 0x3eba66bd 0x9a7443d8 0x22d9bec0 0x4a23663 0xccbd0232 0x849b47dd 0xeef2681c 0x4d5b8c22 0x28f12043 0x11012fd3 0x8ba770c8 0xe40fea1b 0x2ca1588b 0x4794980e 0x86ce16a5 0xfc4909c 0x81dff12 0xf8495c59 0x4d4710f 0x915b1dfd>;
                        rsa,exponent = <0x0 0x10001>;
                        rsa,n0-inverse = <0xb6458ab>;
                        rsa,num-bits = <0x800>;
                        required = "conf";
                        algo = "sha1,rsa2048";
                        key-name-hint = "dev";
                };
        };
};
